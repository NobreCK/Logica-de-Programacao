#include <Adafruit_GFX.h>
#include <Adafruit_ST7735.h>
#include <SPI.h>

#define TFT_CS   10
#define TFT_RST  15
#define TFT_DC   16 
#define TFT_MOSI 11 
#define TFT_SCLK 12
#define FLIPPER_ORANGE 0xFD20 

Adafruit_ST7735 tft = Adafruit_ST7735(TFT_CS, TFT_DC, TFT_MOSI, TFT_SCLK, TFT_RST);

const int btnUp = 4;
const int btnSelect = 5;
const int btnDown = 6;

const int AJUSTE_CENTRO = 2; 

int itemselecionado = 0;   
int totalitens = 5; 

enum EstadoTela { PRINCIPAL, REDES, INFRAVERMELHO };
EstadoTela estadoatual = PRINCIPAL;

const char* menuRedes[] = {"Derrubar e clonar", "Derrubar", "Jammer", "Captura de info com portal de login", "Voltar"};
const char* menuInfravermelho[] = {"Desligar", "Ligar", "Outros", "Voltar"};

const unsigned char icone_antena_32x32[] PROGMEM = {
  0x00, 0x00, 0x00, 0x00, 0x00, 0x40, 0x02, 0x00, 0x00, 0xC0, 0x03, 0x00, 0x01, 0x90, 0x09, 0x80, 0x03, 0x30, 0x0C, 0xC0, 0x06, 0x63, 0xC6, 0x60, 0x04, 0xC7, 0xE3, 0x20, 0x0C, 0xCF, 0xF3, 0x30,
  0x0C, 0xCF, 0xF3, 0x30, 0x0C, 0xCF, 0xF3, 0x30, 0x04, 0xC7, 0xE3, 0x20, 0x06, 0x63, 0xC6, 0x60, 0x03, 0x30, 0x0C, 0xC0, 0x01, 0x91, 0x89, 0x80, 0x00, 0xC3, 0xC3, 0x00, 0x00, 0x43, 0xC2, 0x00,
  0x00, 0x07, 0xE0, 0x00, 0x00, 0x07, 0xE0, 0x00, 0x00, 0x0D, 0xB0, 0x00, 0x00, 0x09, 0x90, 0x00, 0x00, 0x11, 0x88, 0x00, 0x00, 0x1F, 0xF8, 0x00, 0x00, 0x3C, 0x3C, 0x00, 0x00, 0x38, 0x1C, 0x00,
  0x00, 0x70, 0x0E, 0x00, 0x00, 0x7F, 0xFE, 0x00, 0x00, 0xE1, 0x87, 0x00, 0x00, 0xC1, 0x83, 0x00,   0x01, 0xC3, 0xC3, 0x80, 0x01, 0x87, 0xE1, 0x80, 0x03, 0x9F, 0xF9, 0xC0, 0x03, 0xFF, 0xFF, 0xC0,

};

const unsigned char icone_wifi_32x32[] PROGMEM = {
  0x00, 0x07, 0xe0, 0x00, 0x00, 0x3f, 0xfc, 0x00, 0x00, 0xf0, 0x0f, 0x00, 0x03, 0xc0, 0x03, 0xc0, 0x07, 0x00, 0x00, 0xe0, 0x0c, 0x1f, 0xf8, 0x30, 0x18, 0x7f, 0xfe, 0x18, 0x10, 0xf0, 0x0f, 0x08,
  0x00, 0xc0, 0x03, 0x00, 0x01, 0x87, 0xe1, 0x80, 0x03, 0x0f, 0xf0, 0xc0, 0x02, 0x1c, 0x38, 0x40, 0x00, 0x38, 0x1c, 0x00, 0x00, 0x30, 0x0c, 0x00, 0x00, 0x03, 0xc0, 0x00, 0x00, 0x07, 0xe0, 0x00,
  0x00, 0x06, 0x60, 0x00, 0x00, 0x00, 0x00, 0x00, 0x00, 0x01, 0x80, 0x00, 0x00, 0x03, 0xc0, 0x00, 0x00, 0x03, 0xc0, 0x00, 0x00, 0x01, 0x80, 0x00, 0x00, 0x00, 0x00, 0x00, 0x00, 0x00, 0x00, 0x00,
  0x00, 0x00, 0x00, 0x00, 0x00, 0x00, 0x00, 0x00, 0x00, 0x00, 0x00, 0x00, 0x00, 0x00, 0x00, 0x00, 0x00, 0x00, 0x00, 0x00, 0x00, 0x00, 0x00, 0x00, 0x00, 0x00, 0x00, 0x00, 0x00, 0x00, 0x00, 0x00
};

const unsigned char icone_clima_32x32[] PROGMEM = {
  0x00, 0x00, 0x00, 0x00,  0x00, 0x00, 0x00, 0x00,  0x00, 0x00, 0x00, 0x00,  0x00, 0x00, 0x00, 0x00, 0x00, 0x00, 0x00, 0x00,  0x00, 0x00, 0xFF, 0x00,  0x00, 0x01, 0x00, 0x80,  0x00, 0x02, 0x00, 0x40,
  0x00, 0x04, 0x00, 0x20,  0x01, 0xFC, 0x00, 0x20,  0x0F, 0xFC, 0x00, 0x20,  0x1F, 0xFC, 0x00, 0x20, 0x3F, 0xFF, 0x00, 0x20,  0x3F, 0xFF, 0xF0, 0x60,  0x3F, 0xFF, 0xFF, 0x40,  0x7F, 0xFF, 0xFF, 0xFC, 
  0x7F, 0xFF, 0xFF, 0xFE,  0x7F, 0xFF, 0xFF, 0xFE,  0x3F, 0xFF, 0xFF, 0xFE,  0x3F, 0xFF, 0xFF, 0xFE, 0x3F, 0xFF, 0xFF, 0xFE,  0x1F, 0xFF, 0xFF, 0xFE,  0x0F, 0xFF, 0xFF, 0xFC,  0x07, 0xFF, 0xFF, 0xFC,
  0x01, 0xFF, 0xFF, 0xF8,  0x00, 0x7F, 0xFF, 0xF0,  0x00, 0x07, 0xFC, 0x00,  0x00, 0x00, 0x00, 0x00, 0x00, 0x00, 0x00, 0x00,  0x00, 0x00, 0x00, 0x00,  0x00, 0x00, 0x00, 0x00,  0x00, 0x00, 0x00, 0x00
};

const unsigned char icone_ia_32x32[] PROGMEM = {
  0x00, 0x03, 0xc0, 0x00, 0x00, 0x03, 0xc0, 0x00, 0x00, 0x01, 0x80, 0x00, 0x00, 0x07, 0xe0, 0x00, 0x00, 0x1f, 0xf8, 0x00, 0x00, 0x7f, 0xfe, 0x00, 0x00, 0xff, 0xff, 0x00, 0x01, 0xc0, 0x03, 0x80,
  0x03, 0x98, 0x19, 0xc0, 0x03, 0x3c, 0x3c, 0xc0, 0x03, 0x3c, 0x3c, 0xc0, 0x03, 0x18, 0x18, 0xc0, 0x03, 0x00, 0x00, 0xc0, 0x03, 0x3f, 0xfc, 0xc0, 0x03, 0x00, 0x00, 0xc0, 0x01, 0x80, 0x01, 0x80, 
  0x01, 0x3c, 0x3c, 0x80, 0x00, 0x7f, 0xfe, 0x00, 0x00, 0x3f, 0xfc, 0x00, 0x00, 0x1f, 0xf8, 0x00, 0x00, 0x00, 0x00, 0x00, 0x00, 0x00, 0x00, 0x00, 0x00, 0x00, 0x00, 0x00, 0x00, 0x00, 0x00, 0x00,
  0x00, 0x00, 0x00, 0x00, 0x00, 0x00, 0x00, 0x00, 0x00, 0x00, 0x00, 0x00, 0x00, 0x00, 0x00, 0x00, 0x00, 0x00, 0x00, 0x00, 0x00, 0x00, 0x00, 0x00, 0x00, 0x00, 0x00, 0x00, 0x00, 0x00, 0x00, 0x00
};

const unsigned char icone_rf_32x32[] PROGMEM = {
  0x00, 0x00, 0x00, 0x00, 0x00, 0x60, 0x06, 0x00, 0x00, 0xC0, 0x03, 0x00,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 0x0C, 
  0xCF, 0xF3, 0x30, 0x0C, 0xCF, 0xF3, 0x30, 0x0C, 0xCF, 0xF3, 0x30, 0x0C,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 0x03, 
  0xC0, 0xC0, 0x01, 0x87, 0xE1, 0x80, 0x00, 0xC7, 0xE3, 0x00, 0x00, 0x0F,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 0xFC, 
  0x00, 0x00, 0x7F, 0xFE, 0x00, 0x00, 0x7F, 0xFE, 0x00, 0x00, 0xFF, 0xFF, 0x00, 0x00, 0xFF, 0xFF, 0x00, 0x00, 0x00, 0x00, 0x00, 0x00, 0x00, 0x00, 0x00, 0x00, 0x00, 0x00, 0x00,
};

void carregarmenus();
void clima();
void ia();
void rf();
void iniciarTopo();
void desenharInterfaceCarrossel();
void printCentro(const char* texto, int y, int tamanho, bool altura, bool sublinhar);
void desenharIconeComEscala(int16_t x, int16_t y, const unsigned char *bitmap, int16_t w, int16_t h, uint16_t col, uint8_t escala);
void limparEsquerdaParaDireita(uint16_t corDeFundo);
void limparDireitaparaEsquerda(uint16_t corDeFundo);

void setup() {
    pinMode(btnUp, INPUT_PULLUP);
    pinMode(btnSelect, INPUT_PULLUP);
    pinMode(btnDown, INPUT_PULLUP);

    tft.initR(INITR_BLACKTAB); 
    tft.setRotation(1); 
    tft.setTextSize(1); 
    
    tft.fillScreen(ST7735_BLACK); 
    
    iniciarTopo();
    desenharInterfaceCarrossel();
}

void loop() {
    if (digitalRead(btnUp) == LOW) {
        itemselecionado--;
        if (itemselecionado < 0) {
            itemselecionado = totalitens - 1; 
        }
        
        if (estadoatual == PRINCIPAL) {
            limparDireitaparaEsquerda(ST7735_BLACK); 
            desenharInterfaceCarrossel();
        } else {
            carregarmenus();
        }
        
        delay(50);
        while (digitalRead(btnUp) == LOW);
    }

    if (digitalRead(btnDown) == LOW) {
        itemselecionado++;
        if (itemselecionado >= totalitens) {
            itemselecionado = 0; 
        }

        if (estadoatual == PRINCIPAL) {
            limparEsquerdaParaDireita(ST7735_BLACK); 
            desenharInterfaceCarrossel(); 
        } else {
            carregarmenus();
        }
        
        delay(50);
        while (digitalRead(btnDown) == LOW);
    }
                                       // BOTAR AS ACOES OU CHAMADAS DE INTERFACES AQUI
    if (digitalRead(btnSelect) == LOW) {
        if (estadoatual == PRINCIPAL) {                   
            if (itemselecionado == 0) {estadoatual = INFRAVERMELHO; totalitens = 4; itemselecionado = 2; tft.fillScreen(ST7735_BLACK); iniciarTopo(); carregarmenus(); return;}
            else if (itemselecionado == 1) {estadoatual = REDES; totalitens = 5; itemselecionado = 2; tft.fillScreen(ST7735_BLACK); iniciarTopo(); carregarmenus(); return;}
            else if (itemselecionado == 2) {clima(); return;}
            else if (itemselecionado == 3) {ia(); return;}
#include <Adafruit_GFX.h>
#include <Adafruit_ST7735.h>
#include <SPI.h>

#define TFT_CS   10
#define TFT_RST  15
#define TFT_DC   16 
#define TFT_MOSI 11 
#define TFT_SCLK 12
#define FLIPPER_ORANGE 0xFD20 

Adafruit_ST7735 tft = Adafruit_ST7735(TFT_CS, TFT_DC, TFT_MOSI, TFT_SCLK, TFT_RST);

const int btnUp = 4;
const int btnSelect = 5;
const int btnDown = 6;

const int AJUSTE_CENTRO = 2; 

int itemselecionado = 0;   
int totalitens = 5; 

enum EstadoTela { PRINCIPAL, REDES, INFRAVERMELHO };
EstadoTela estadoatual = PRINCIPAL;

const char* menuRedes[] = {"Derrubar e clonar", "Derrubar", "Jammer", "Captura de info com portal de login", "Voltar"};
const char* menuInfravermelho[] = {"Desligar", "Ligar", "Outros", "Voltar"};

const unsigned char icone_antena_32x32[] PROGMEM = {
  0x00, 0x00, 0x00, 0x00, 0x00, 0x40, 0x02, 0x00, 0x00, 0xC0, 0x03, 0x00, 0x01, 0x90, 0x09, 0x80, 0x03, 0x30, 0x0C, 0xC0, 0x06, 0x63, 0xC6, 0x60, 0x04, 0xC7, 0xE3, 0x20, 0x0C, 0xCF, 0xF3, 0x30,
  0x0C, 0xCF, 0xF3, 0x30, 0x0C, 0xCF, 0xF3, 0x30, 0x04, 0xC7, 0xE3, 0x20, 0x06, 0x63, 0xC6, 0x60, 0x03, 0x30, 0x0C, 0xC0, 0x01, 0x91, 0x89, 0x80, 0x00, 0xC3, 0xC3, 0x00, 0x00, 0x43, 0xC2, 0x00,
  0x00, 0x07, 0xE0, 0x00, 0x00, 0x07, 0xE0, 0x00, 0x00, 0x0D, 0xB0, 0x00, 0x00, 0x09, 0x90, 0x00, 0x00, 0x11, 0x88, 0x00, 0x00, 0x1F, 0xF8, 0x00, 0x00, 0x3C, 0x3C, 0x00, 0x00, 0x38, 0x1C, 0x00,
  0x00, 0x70, 0x0E, 0x00, 0x00, 0x7F, 0xFE, 0x00, 0x00, 0xE1, 0x87, 0x00, 0x00, 0xC1, 0x83, 0x00,   0x01, 0xC3, 0xC3, 0x80, 0x01, 0x87, 0xE1, 0x80, 0x03, 0x9F, 0xF9, 0xC0, 0x03, 0xFF, 0xFF, 0xC0,

};

const unsigned char icone_wifi_32x32[] PROGMEM = {
  0x00, 0x07, 0xe0, 0x00, 0x00, 0x3f, 0xfc, 0x00, 0x00, 0xf0, 0x0f, 0x00, 0x03, 0xc0, 0x03, 0xc0, 0x07, 0x00, 0x00, 0xe0, 0x0c, 0x1f, 0xf8, 0x30, 0x18, 0x7f, 0xfe, 0x18, 0x10, 0xf0, 0x0f, 0x08,
  0x00, 0xc0, 0x03, 0x00, 0x01, 0x87, 0xe1, 0x80, 0x03, 0x0f, 0xf0, 0xc0, 0x02, 0x1c, 0x38, 0x40, 0x00, 0x38, 0x1c, 0x00, 0x00, 0x30, 0x0c, 0x00, 0x00, 0x03, 0xc0, 0x00, 0x00, 0x07, 0xe0, 0x00,
  0x00, 0x06, 0x60, 0x00, 0x00, 0x00, 0x00, 0x00, 0x00, 0x01, 0x80, 0x00, 0x00, 0x03, 0xc0, 0x00, 0x00, 0x03, 0xc0, 0x00, 0x00, 0x01, 0x80, 0x00, 0x00, 0x00, 0x00, 0x00, 0x00, 0x00, 0x00, 0x00,
  0x00, 0x00, 0x00, 0x00, 0x00, 0x00, 0x00, 0x00, 0x00, 0x00, 0x00, 0x00, 0x00, 0x00, 0x00, 0x00, 0x00, 0x00, 0x00, 0x00, 0x00, 0x00, 0x00, 0x00, 0x00, 0x00, 0x00, 0x00, 0x00, 0x00, 0x00, 0x00
};

const unsigned char icone_clima_32x32[] PROGMEM = {
  0x00, 0x00, 0x00, 0x00,  0x00, 0x00, 0x00, 0x00,  0x00, 0x00, 0x00, 0x00,  0x00, 0x00, 0x00, 0x00, 0x00, 0x00, 0x00, 0x00,  0x00, 0x00, 0xFF, 0x00,  0x00, 0x01, 0x00, 0x80,  0x00, 0x02, 0x00, 0x40,
  0x00, 0x04, 0x00, 0x20,  0x01, 0xFC, 0x00, 0x20,  0x0F, 0xFC, 0x00, 0x20,  0x1F, 0xFC, 0x00, 0x20, 0x3F, 0xFF, 0x00, 0x20,  0x3F, 0xFF, 0xF0, 0x60,  0x3F, 0xFF, 0xFF, 0x40,  0x7F, 0xFF, 0xFF, 0xFC, 
  0x7F, 0xFF, 0xFF, 0xFE,  0x7F, 0xFF, 0xFF, 0xFE,  0x3F, 0xFF, 0xFF, 0xFE,  0x3F, 0xFF, 0xFF, 0xFE, 0x3F, 0xFF, 0xFF, 0xFE,  0x1F, 0xFF, 0xFF, 0xFE,  0x0F, 0xFF, 0xFF, 0xFC,  0x07, 0xFF, 0xFF, 0xFC,
  0x01, 0xFF, 0xFF, 0xF8,  0x00, 0x7F, 0xFF, 0xF0,  0x00, 0x07, 0xFC, 0x00,  0x00, 0x00, 0x00, 0x00, 0x00, 0x00, 0x00, 0x00,  0x00, 0x00, 0x00, 0x00,  0x00, 0x00, 0x00, 0x00,  0x00, 0x00, 0x00, 0x00
};

const unsigned char icone_ia_32x32[] PROGMEM = {
  0x00, 0x03, 0xc0, 0x00, 0x00, 0x03, 0xc0, 0x00, 0x00, 0x01, 0x80, 0x00, 0x00, 0x07, 0xe0, 0x00, 0x00, 0x1f, 0xf8, 0x00, 0x00, 0x7f, 0xfe, 0x00, 0x00, 0xff, 0xff, 0x00, 0x01, 0xc0, 0x03, 0x80,
  0x03, 0x98, 0x19, 0xc0, 0x03, 0x3c, 0x3c, 0xc0, 0x03, 0x3c, 0x3c, 0xc0, 0x03, 0x18, 0x18, 0xc0, 0x03, 0x00, 0x00, 0xc0, 0x03, 0x3f, 0xfc, 0xc0, 0x03, 0x00, 0x00, 0xc0, 0x01, 0x80, 0x01, 0x80, 
  0x01, 0x3c, 0x3c, 0x80, 0x00, 0x7f, 0xfe, 0x00, 0x00, 0x3f, 0xfc, 0x00, 0x00, 0x1f, 0xf8, 0x00, 0x00, 0x00, 0x00, 0x00, 0x00, 0x00, 0x00, 0x00, 0x00, 0x00, 0x00, 0x00, 0x00, 0x00, 0x00, 0x00,
  0x00, 0x00, 0x00, 0x00, 0x00, 0x00, 0x00, 0x00, 0x00, 0x00, 0x00, 0x00, 0x00, 0x00, 0x00, 0x00, 0x00, 0x00, 0x00, 0x00, 0x00, 0x00, 0x00, 0x00, 0x00, 0x00, 0x00, 0x00, 0x00, 0x00, 0x00, 0x00
};

const unsigned char icone_rf_32x32[] PROGMEM = {
  0x00, 0x00, 0x00, 0x00, 0x00, 0x60, 0x06, 0x00, 0x00, 0xC0, 0x03, 0x00,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 0x0C, 
  0xCF, 0xF3, 0x30, 0x0C, 0xCF, 0xF3, 0x30, 0x0C, 0xCF, 0xF3, 0x30, 0x0C,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 0x03, 
  0xC0, 0xC0, 0x01, 0x87, 0xE1, 0x80, 0x00, 0xC7, 0xE3, 0x00, 0x00, 0x0F,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 0xFC, 
  0x00, 0x00, 0x7F, 0xFE, 0x00, 0x00, 0x7F, 0xFE, 0x00, 0x00, 0xFF, 0xFF, 0x00, 0x00, 0xFF, 0xFF, 0x00, 0x00, 0x00, 0x00, 0x00, 0x00, 0x00, 0x00, 0x00, 0x00, 0x00, 0x00, 0x00,
};

void carregarmenus();
void clima();
void ia();
void rf();
void limparEsquerdaParaDireita(uint16_t corDeFundo);
    if (digitalRead(btnUp) == LOW) {
        itemselecionado--;
        
        itemselecionado++;

        if (estadoatual == PRINCIPAL) {
            limparEsquerdaParaDireita(ST7735_BLACK); 
            desenharInterfaceCarrossel(); 
        } else {
            carregarmenus();
        }
        
        delay(50);
        while (digitalRead(btnDown) == LOW);
    }
                                       // BOTAR AS ACOES OU CHAMADAS DE INTERFACES AQUI
    if (digitalRead(btnSelect) == LOW) {
        if (estadoatual == PRINCIPAL) {                   
            if (itemselecionado == 0) {estadoatual = INFRAVERMELHO; totalitens = 4; itemselecionado = 2; tft.fillScreen(ST7735_BLACK); iniciarTopo(); carregarmenus(); return;}
            else if (itemselecionado == 1) {estadoatual = REDES; totalitens = 5; itemselecionado = 2; tft.fillScreen(ST7735_BLACK); iniciarTopo(); carregarmenus(); return;}
            else if (itemselecionado == 2) {clima(); return;}
            else if (itemselecionado == 3) {ia(); return;}
            else if (itemselecionado == 4) {rf(); return;}
        } else {
            // Lógica para o botão "Voltar" dentro dos submenus restaurar o Menu Principal de ícones
            if ((estadoatual == REDES && itemselecionado == 4) || (estadoatual == INFRAVERMELHO && itemselecionado == 3)) {
                estadoatual = PRINCIPAL;
                totalitens = 5;
                itemselecionado = 0;
                tft.fillScreen(ST7735_BLACK);
                iniciarTopo();
                desenharInterfaceCarrossel();
                return;
            }
        return;
        }
        delay(300);

        limparEsquerdaParaDireita(ST7735_BLACK); 
        iniciarTopo();                
        desenharInterfaceCarrossel(); 
        while (digitalRead(btnSelect) == LOW);
    }
}

void iniciarTopo() {
}
    int yBaseCentro = (tft.height() / 2) - 32;      
            break;

        case 3:
            desenharIconeComEscala(xBaseCentro + 1, yBaseCentro + 8, icone_ia_32x32, 32, 32, ST7735_CYAN, 2);
            printCentro("IA", y, 1, false, false);
            break;

        case 4:
            desenharIconeComEscala(xBaseCentro + 1, yBaseCentro + 8, icone_rf_32x32, 32, 32, ST7735_CYAN, 2);
}
// printando tambem alem de centralizar, precisamos ainda de valor y
// 1. Tiramos os "returns" proibidos e deixamos a função desenhar e calcular normal
void printCentro(const char* texto, int y, int tamanho, bool altura, bool sublinhar) {
    int comprimento = strlen(texto);
    int larguraTexto = comprimento * (6 * tamanho); 
    int x = (tft.width() / 2) - (larguraTexto / 2) + AJUSTE_CENTRO;
    int alturatexto = 8 * tamanho; // Movido para fora do if para funcionar globalmente

    if (altura) {
        // Se altura for true, calcula o centro vertical da tela (128 / 2 = 64) e desconta a letra
        y = (tft.height() / 2) - (alturatexto / 2);
    }

    tft.setTextSize(tamanho);
    tft.setCursor(x, y);
    tft.print(texto);

    if (sublinhar) {
        int yLinha = y + alturatexto + 1;
        // Corrigido para drawFastHLine (o drawline original pedia coordenadas finais X,Y)
        tft.drawFastHLine(x, yLinha, larguraTexto, ST7735_WHITE);
    }
    tft.setTextSize(1); // Reseta a fonte para o padrão
}

void carregarmenus() {
    const char* const* menuItens;
    
    switch (estadoatual) {
        case REDES:
            menuItens = menuRedes;
            break;
        case INFRAVERMELHO:
            menuItens = menuInfravermelho;
            break;
        default:
            return;
    }
    tft.fillRect(6, 18, tft.width() - 12, tft.height() - 28, ST7735_BLACK); // ✅ limpa só a área do conteúdo
    for (int i = 0; i < totalitens; i++) {
        int distancia = i - itemselecionado;

        if (i == itemselecionado) {
            tft.setTextColor(ST7735_WHITE); // 💡 Garante que o selecionado seja sempre BRANCO
            printCentro(menuItens[i], 0, 2, true, true); // Centraliza X e Y automaticamente
        }
        else {    
            // 💡 Pegamos o meio real da tela e aplicamos o seu cálculo de distância perfeito!
            int ycalculado = (tft.height() / 2) + (distancia * 24); 
            
            // Como os itens menores (tam 1) começam o desenho pelo topo da letra, 
            // precisamos recuar 4 pixels (metade de 8) para que o MEIO do texto menor 
            // alinhe com a linha do ycalculado!
            ycalculado = ycalculado - 4;

            if (ycalculado > 15 && ycalculado < 115) {
                tft.setTextColor(0x7BEF); // Cor cinza escura
                // 💡 MUDADO PARA FALSE: Usa o ycalculado que você descobriu com tanto esforço!
                printCentro(menuItens[i], ycalculado, 1, false, false); 
            }
        }
    }
}

void desenharIconeComEscala(int16_t x, int16_t y, const unsigned char *bitmap, int16_t w, int16_t h, uint16_t col, uint8_t escala) {
    int16_t i, j, byteWidth = (w + 7) / 8;
    uint8_t b = 0;

    for (j = 0; j < h; j++) {
        for (i = 0; i < w; i++) {
            if (i & 7) b <<= 1;
            else b = pgm_read_byte(&bitmap[j * byteWidth + i / 8]);
            
            if (b & 0x80) {
                tft.fillRect(x + (i * escala), y + (j * escala), escala, escala, col);
            }
        }
    }
}



// quanto maior o valor de x mais para direita e quanto maior o valor de y mais para baixo
// Substitua a função de limpeza no final do seu código por esta:
void limparEsquerdaParaDireita(uint16_t corDeFundo) {
    int xBaseCentro = (tft.width() / 2) - 32 + AJUSTE_CENTRO;  
    int yBaseCentro = (tft.height() / 2) - 32; 
    int larguraFatia = 4;

    for (int fx = 0; fx < 80; fx += larguraFatia) {
        tft.fillRect(xBaseCentro - 10 + fx, yBaseCentro + 2, larguraFatia, 84, corDeFundo); // avanca para direita toda vez
            // 42
    }
}

void limparDireitaparaEsquerda(uint16_t corDeFundo) {
    int xBaseCentro = (tft.width() / 2) - 32;  
    int yBaseCentro = (tft.height() / 2) - 32; 
    int largurafatia = 4;

    for (int fx = 0; fx < 80; fx += largurafatia) {     // cortar ate os 4 px
        tft.fillRect(xBaseCentro + 70 - fx, yBaseCentro + 2, largurafatia, 84, corDeFundo);
    }
}

void clima() {
    tft.fillScreen(ST7735_BLACK);
    tft.setCursor(30, 60);
    tft.setTextColor(ST7735_WHITE);
    tft.print("Clima"); // ✅
}
void ia() {
    tft.fillScreen(ST7735_BLACK);
    tft.setCursor(30, 60);
    tft.setTextColor(ST7735_WHITE);
    tft.print("Clima"); // ✅
}
void rf() {
    tft.fillScreen(ST7735_BLACK);
    tft.setCursor(30, 60);
    tft.setTextColor(ST7735_WHITE);
    tft.print("Clima"); // ✅
}
            printCentro("RF", y, 1, false, false);
            break;
    }
    int y = 106;

    tft.setTextColor(ST7735_WHITE);
            desenharIconeComEscala(xBaseCentro, yBaseCentro, icone_antena_32x32, 32, 32, ST7735_CYAN, 2);
            desenharIconeComEscala(xBaseCentro + 1, yBaseCentro + 6, icone_clima_32x32, 32, 32, ST7735_CYAN, 2);
            printCentro("CLIMA", y, 1, false, false);
        case 1:

        case 2:
            desenharIconeComEscala(xBaseCentro, yBaseCentro + 10, icone_wifi_32x32, 32, 32, ST7735_CYAN, 2);
            printCentro("WIFI", y, 1, false, false);
            break;
            printCentro("INFRAVERMELHO", y, 1, false, false); 
            break;


    switch (itemselecionado) {
        case 0:

void desenharInterfaceCarrossel() {
    int xBaseCentro = (tft.width() / 2) - 32 + AJUSTE_CENTRO;  
    tft.fillRect(6, 6, tft.width() - 12, 10, 0x0115); 
    tft.setTextColor(ST7735_WHITE);
    printCentro("NOBRE", 7, 1, false, false);
    tft.setCursor(xSetaDireita, ySetaCentro); tft.print(">");

    tft.drawRect(5, 5, tft.width() - 10, tft.height() - 10, ST7735_BLUE);

    int ySetaCentro = tft.height() / 2 - 4; 
    int xSetaDireita = tft.width() - 18;      

    tft.setTextColor(ST7735_BLUE);
    tft.setCursor(12, ySetaCentro);           tft.print("<");
        if (itemselecionado >= totalitens) {
            itemselecionado = 0; 
        }
    }

    if (digitalRead(btnDown) == LOW) {
        if (estadoatual == PRINCIPAL) {
            carregarmenus();
        }
        
        delay(50);
        while (digitalRead(btnUp) == LOW);
            limparDireitaparaEsquerda(ST7735_BLACK); 
            desenharInterfaceCarrossel();
        } else {
        if (itemselecionado < 0) {
            itemselecionado = totalitens - 1; 
        }
void limparDireitaparaEsquerda(uint16_t corDeFundo);

void loop() {

void setup() {
    pinMode(btnUp, INPUT_PULLUP);
    pinMode(btnSelect, INPUT_PULLUP);
    tft.setRotation(1); 
    tft.setTextSize(1); 
    
    tft.fillScreen(ST7735_BLACK); 
    
    iniciarTopo();
    desenharInterfaceCarrossel();
}
    pinMode(btnDown, INPUT_PULLUP);

    tft.initR(INITR_BLACKTAB); 
void iniciarTopo();
void printCentro(const char* texto, int y, int tamanho, bool altura, bool sublinhar);
void desenharIconeComEscala(int16_t x, int16_t y, const unsigned char *bitmap, int16_t w, int16_t h, uint16_t col, uint8_t escala);

